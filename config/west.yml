## config/west.yml
```yaml
manifest:
  remotes:
    - name: zmkfirmware
      url-base: https://github.com/zmkfirmware
    - name: urob
      url-base: https://github.com/urob
    - name: janpfischer
      url-base: https://github.com/janpfischer
  projects:
    - name: zmk
      remote: zmkfirmware
      revision: 484a0547078228f6957ed164523823e39fbedec4
      import: app/west.yml
    - name: zmk-helpers
      remote: urob
      revision: bc114546392b4615ac90a99140eaf21dde31209d
    - name: zmk-dongle-screen
      remote: janpfischer
      revision: upgrade-4.1
  self:
    path: config
```
